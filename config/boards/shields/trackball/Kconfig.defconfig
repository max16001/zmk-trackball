## config/boards/shields/trackball/Kconfig.defconfig
```kconfig
if SHIELD_TRACKBALL

config ZMK_KEYBOARD_NAME
    default "The TrackBall"

endif
```

## config/boards/shields/trackball/Kconfig.shield
```kconfig
# Copyright (c) 2020 ZMK Contributors
# SPDX-License-Identifier: MIT

config SHIELD_TRACKBALL
    def_bool $(shields_list_contains,trackball)
```

## config/west.yml
```yaml
manifest:
  remotes:
    - name: zmkfirmware
      url-base: https://github.com/petejohanson
    - name: badjeff
      url-base: https://github.com/badjeff
    - name: zmkfirmware
      url-base: https://github.com/zmkfirmware

  projects:
    - name: zmk
      remote: zmkfirmware
      revision: main
      # revision: feat/pointers-move-scroll
      import: app/west.yml
    - name: zmk-pmw3610-driver
      remote: badjeff
      revision: main
    
  self:
    path: config
    
```
